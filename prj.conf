## CMakeLists.txt
```
cmake_minimum_required(VERSION 3.20.0)

find_package(Zephyr REQUIRED HINTS $ENV{ZEPHYR_BASE})
project(nrf52840_rtos_vth)

FILE(GLOB app_sources src/*.c)
target_sources(app PRIVATE ${app_sources})
```

## prj.conf
```kconfig
# Debugger Support
CONFIG_UART_CONSOLE=n
CONFIG_CONSOLE=y
CONFIG_SERIAL=y

# RTT Segger Support
CONFIG_RTT_CONSOLE=y
CONFIG_USE_SEGGER_RTT=y
CONFIG_LOG_BACKEND_RTT=y


# Communication Bus Support
CONFIG_GPIO=y
CONFIG_SPI=y
CONFIG_I2C=y

# Hardware Support
CONFIG_SENSOR=y
CONFIG_ADC=y

# Flash Memory Support
CONFIG_FLASH=y
CONFIG_FLASH_MAP=y
CONFIG_MPU_ALLOW_FLASH_WRITE=y
```

## boards/mdbt50q_lora_dev.overlay
```dts
/*
 * Copyright (c) 2025
 * Regis Rousseau
 * Univ Lyon, INSA Lyon, Inria, CITI, EA3720
 * SPDX-License-Identifier: Apache-2.0
 */

/* VBAT battery voltage monitoring */
/* external ADC channnel of MDBT50Q, Port P0.03 on schematic */
/ {
	zephyr,user {
		io-channels = <&adc 1>;
	};
};

/* enable the corresponding ADC, with the correct configuration */
&adc {
	#address-cells = <1>;
	#size-cells = <0>;
	status = "okay";
	channel@1 {
		reg = <1>;											/* channel 1 of the ADC */
		zephyr,gain = "ADC_GAIN_1_6";						/* attenuated by 6 (x1/6) */
		zephyr,reference = "ADC_REF_INTERNAL";				/* reference voltage +0.6 */
		zephyr,acquisition-time = <ADC_ACQ_TIME_DEFAULT>;	/* 10us */
		zephyr,input-positive = <NRF_SAADC_AIN1>;			/* P0.03 for nRF52xx */
		zephyr,resolution = <12>;
	};
};
```

## src/main.c
```c
/*
 * Copyright (c) 2025
 * Regis Rousseau
 * Univ Lyon, INSA Lyon, Inria, CITI, EA3720
 * SPDX-License-Identifier: Apache-2.0
 */

//  ========== includes ====================================================================
#include "app_flash.h"
#include "app_sht31.h"
#include "app_vbat.h"

//  ========== interrupt sub-routine =======================================================
void sens_work_handler(struct k_work *work_rtc)
{
	// retrieve the sensor device using the device tree API
	const struct device *sht31_dev = DEVICE_DT_GET_ONE(sensirion_sht3xd);
	if (!device_is_ready(sht31_dev)) {
        printk("%s: sensor device not ready\n", sht31_dev->name);
        return -ENODEV;
    }
	
	// printk("two sensors test and W/R flash memory test\n");
 	// int8_t ret = app_flash_handler(sht31_dev);
	// if (ret != 1) {
	// 	printk("failed to call sensor handler");
	// 	return 0;
	// }

	printk("only the two sensors test: ADC & SHT31\n");

	int16_t bat = app_nrf52_get_vbat();
	printk("battery level (int16): %d%%\n", bat);

	int16_t temp = app_sht31_get_temp(sht31_dev);
	printk("SHT31 temperature (int16): %d\n", temp);

	k_msleep(5000);		// small delay  between reading the temperature and humidity values

	int16_t hum = app_sht31_get_hum(sht31_dev);
	printk("SHT31 humidity (int16): %d\n", hum);
}
K_WORK_DEFINE(sens_work, sens_work_handler);

void sens_timer_handler(struct k_timer *rtc_dum)
{
	k_work_submit(&sens_work);
}
K_TIMER_DEFINE(sens_timer, sens_timer_handler, NULL);

//  ========== main ========================================================================
int main(void)
{

	// initialize ADC device
	int8_t ret = app_nrf52_vbat_init();
	if (ret != 1) {
		printk("failed to initialize ADC device");
		return 0;
	}
	printk("adc device initialized\n");

	// initialize partition flash memory
	ret = app_flash_init();
	if (ret != 1) {
		printk("failed to initialize internal Flash device\n");
		return 0;
	}

	printk("Sensor SHT31 and Battery Example\n");

	// start the timer to trigger the interrupt subroutine every 30 seconds
	k_timer_start(&sens_timer, K_NO_WAIT, K_SECONDS(30));		// 30s for test
	return 0;
}
```

## src/app_flash.c
```c
/*
 * Copyright (c) 2023
 * Regis Rousseau
 * Univ Lyon, INSA Lyon, Inria, CITI, EA3720
 * SPDX-License-Identifier: Apache-2.0
 */

//  ========== includes ====================================================================
#include "app_vbat.h"
#include "app_sht31.h"
#include "app_flash.h"

//  ========== globals =====================================================================
struct flash_header {
    uint32_t magic;
    uint32_t head;
};

//  ========== app_flash_init ==============================================================
int8_t app_flash_init()
{
	const struct flash_area *fa;
	int8_t  ret = flash_area_open(FIXED_PARTITION_ID(storage_partition), &fa);
	if (ret != 0) {
    	printk("Failed to open flash area\n");
    	return -1;
	}
	
	struct flash_header hdr;
	flash_area_read(fa, FLASH_HEAD_OFFSET, &hdr, sizeof(hdr));

	if (hdr.magic != MAGIC_KEY) {
		printk("flash not initialized. initializing now.\n");

		// erase first sector
		flash_area_erase(fa, FLASH_HEAD_OFFSET, FLASH_SECTOR_SIZE);

		// write new header
		hdr.magic = MAGIC_KEY;
		hdr.head = 0;
		flash_area_write(fa, FLASH_HEAD_OFFSET, &hdr, sizeof(hdr));
	} else {
		printk("flash already initialized. Head: %u\n", hdr.head);
	}
	flash_area_close(fa);
	return 1;
}

//  ========== app_flash_store =======================================================================
int8_t app_flash_store(const struct vth *data)
{
    const struct flash_area *fa;
    int8_t ret = flash_area_open(FIXED_PARTITION_ID(storage_partition), &fa);
    if (ret != 0) {
        printk("failed to open flash area\n");
        return -1;
    }

    // read head from the head sector
    uint32_t head = 0;
    flash_area_read(fa, 0, &head, sizeof(head));  // head at offset 0

    // compute current data offset
    uint32_t index = head % MAX_RECORDS;
    off_t data_offset = FLASH_DATA_OFFSET + index * RECORD_SIZE;

    // erase sector only when writing first record of a sector
	uint32_t records_per_sector = FLASH_SECTOR_SIZE / RECORD_SIZE;
	if ((index % records_per_sector) == 0) {
		off_t sector_offset = data_offset & ~(FLASH_SECTOR_SIZE - 1);
		ret = flash_area_erase(fa, sector_offset, FLASH_SECTOR_SIZE);
		if (ret != 0) {
			printk("erase failed at offset 0x%x\n", (uint32_t)sector_offset);
			flash_area_close(fa);
			return -1;
		}
	}

    // write record
    ret = flash_area_write(fa, data_offset, data, RECORD_SIZE);
    if (ret != 0) {
        printk("write failed at offset 0x%x\n", (uint32_t)data_offset);
        flash_area_close(fa);
        return -1;
    }

    // Update head
    head = (head + 1) % MAX_RECORDS;
    flash_area_write(fa, 0, &head, sizeof(head));
    if (ret != 0) {
		printk("failed to update head\n");
		flash_area_close(fa);
		return -1;
	}
    flash_area_close(fa);
    return 0;
}

//  ========== app_flash_handler =====================================================================
int8_t app_flash_handler(const struct device *dev)
{
	struct vth data;

	// retrieve the sensor device using the device tree API
	if (!device_is_ready(dev)) {
        printk("%s: sensor device not ready\n", dev->name);
        return -1;
    }

	// collect sensor data until the maximum number of records is reached
	// measure and store the battery voltage
	data.vbat = app_nrf52_get_vbat();

	// measure and store the temperature using the SHT31 sensor
	data.temp = app_sht31_get_temp(dev);

	k_msleep(5000);		// small delay  between reading the temperature and humidity values

	// measure and store the humidity using the SHT31 sensor
	data.hum = app_sht31_get_hum(dev);

	// save the collected sensor data into the flash memory
	int8_t ret = app_flash_store(&data);
    return 1;
}
```

## src/app_flash.h
```c
/*
 * Copyright (c) 2023
 * Regis Rousseau
 * Univ Lyon, INSA Lyon, Inria, CITI, EA3720
 * SPDX-License-Identifier: Apache-2.0
 */

#ifndef APP_FLASH_H
#define APP_FLASH_H

//  ========== includes ====================================================================
#include <zephyr/kernel.h>
#include <zephyr/device.h>
#include <zephyr/devicetree.h>
#include <zephyr/drivers/flash.h>
#include <zephyr/storage/flash_map.h>

//  ========== globals =====================================================================
struct vth {
	int16_t vbat;
	int16_t temp;
	int16_t hum;
};

//  ========== defines =====================================================================
#define FLASH_PARTITION_OFFSET  0x000F8000	
#define FLASH_SECTOR_SIZE       4096		// one flash page = 4 KB		
#define FLASH_SECTOR_COUNT      4			// 4 sectors × 4 KB = 16 KB
#define FLASH_TOTAL_SIZE        (FLASH_SECTOR_SIZE * FLASH_SECTOR_COUNT)

#define FLASH_HEAD_OFFSET		0x0000                 
#define FLASH_DATA_OFFSET       0x0100

#define MAX_RECORDS             (0x8000 - FLASH_DATA_OFFSET) / RECORD_SIZE  // = 4064
#define RECORD_SIZE             8 
#define MAGIC_KEY				0xDEADBEEF

//  ========== prototypes ==================================================================
int8_t app_flash_init(void);
int8_t app_flash_store(const struct vth *data);
int8_t app_flash_handler(const struct device *dev);

#endif /* APP_FLASH_H */
```

## src/app_sht31.c
```c
/*
 * Copyright (c) 2025
 * Regis Rousseau
 * Univ Lyon, INSA Lyon, Inria, CITI, EA3720
 * SPDX-License-Identifier: Apache-2.0
 */

//  ========== includes ==============================================================================
#include "app_sht31.h"

//  ========== app_sht31_get_temp ====================================================================
int16_t app_sht31_get_temp(const struct device *dev)
{
    struct sensor_value val;

    // fetch the latest sample from the sensor
	int8_t ret = sensor_sample_fetch(dev);
    if (ret < 0 && ret != -EBADMSG) { 
	    printk("SHT31 device sample is not up to date. error: %d\n", ret);
	    return 0;
    }

    // retrieve the ambient temperature from the sensor
	ret = sensor_channel_get(dev, SENSOR_CHAN_AMBIENT_TEMP, &val);
    if (ret < 0) {
        printk("can't read sensor channels. error: %d\n", ret);
	    return 0;
    }

    // convert the raw temperature value to integer format with scaling
    int32_t temp = (val.val1 * TEMP_SCALE) + ((int64_t)val.val2 * TEMP_SCALE / 1000000);

    // print the temperature value with two decimal places
    printk("SHT31 temperature: %d.%02d °C\n", temp / TEMP_SCALE, temp % TEMP_SCALE);
    return (int16_t)temp;
}

//  ========== app_sht31_get_hum =====================================================================
int16_t app_sht31_get_hum(const struct device *dev)
{
    struct sensor_value val;

    // fetch the latest sample from the sensor
	int8_t ret = sensor_sample_fetch(dev);
    if (ret < 0 && ret != -EBADMSG) { 
	    printk("SHT31 device sample is not up to date. error: %d\n", ret);
	    return 0;
    }

    // retrieve the humidity from the sensor
	ret = sensor_channel_get(dev, SENSOR_CHAN_HUMIDITY, &val);
    if (ret < 0) {
        printk("can't read sensor channels. error: %d\n", ret);
	    return 0;
    }

    // convert the raw humicity value to integer format with scaling
    int32_t hum = (val.val1 * HUM_SCALE) + ((int64_t)val.val2 * HUM_SCALE / 1000000);

    // print the humifity value with two decimal places
    printk("SHT31 humidity: %d.%02d %%RH\n", hum / HUM_SCALE, hum % HUM_SCALE);
    return (int16_t)hum;
}
```

## src/app_sht31.h
```c
/*
 * Copyright (c) 2025
 * Regis Rousseau
 * Univ Lyon, INSA Lyon, Inria, CITI, EA3720
 * SPDX-License-Identifier: Apache-2.0
 */

#ifndef APP_SHT31_H
#define APP_SHT31_H

//  ========== includes ====================================================================
#include <zephyr/kernel.h>
#include <zephyr/device.h>
#include <zephyr/devicetree.h>
#include <zephyr/drivers/sensor.h>
#include <stdint.h>

//  ========== defines =====================================================================
#define TEMP_SCALE  100     // scale for converting to int6_t
#define HUM_SCALE   100     // scale for converting to int16_t
             
//  ========== prototypes ==================================================================
int16_t app_sht31_get_temp(const struct device *dev);
int16_t app_sht31_get_hum(const struct device *dev);

#endif /* APP_SHT31_H */
```

## src/app_vbat.c
```c
/*
 * Copyright (c) 2025
 * Regis Rousseau
 * Univ Lyon, INSA Lyon, Inria, CITI, EA3720
 * SPDX-License-Identifier: Apache-2.0
 */


//  ========== includes ==============================================================================
#include "app_vbat.h"

//  ========== globals ===============================================================================
// ADC buffer to store raw ADC readings
int32_t buf;

// ADC channel configuration obtained from the device tree
static const struct adc_dt_spec adc_channel = ADC_DT_SPEC_GET(DT_PATH(zephyr_user));

// ADC sequence configuration to specify the ADC operation
static struct adc_sequence sequence = {
    .channels = 1,
	.buffer = &buf,
	.buffer_size = sizeof(buf),
};

//  ========== app_nrf52_vbat_init ===================================================================
int8_t app_nrf52_vbat_init()
{
    int8_t ret;

    // verify if the ADC is ready for operation
    if (!adc_is_ready_dt(&adc_channel)) {
		printk("ADC is not ready. error: %d\n", ret);
		return 0;
	}

    // configure the ADC channel settings
    ret = adc_channel_setup_dt(&adc_channel);
	if (ret < 0) {
		printk("failed to set up ADC channel. error: %d\n", ret);
		return 0;
	}

    // initialize the ADC sequence for continuous or single readings
    ret = adc_sequence_init_dt(&adc_channel, &sequence);
	if (ret < 0) {
		printk("failed to initialize ADC sequence. error: %d\n", ret);
		return 0;
	}
    return 1;
}

//  ======== app_nrf52_get_vbat ======================================================================
int16_t app_nrf52_get_vbat()
{
    int16_t percent = 0;

    // read sample from the ADC
    int8_t ret = adc_read(adc_channel.dev, &sequence);
    if (ret < 0 ) {        
	    printk("raw adc value is not up to date. error: %d\n", ret);
	    return 0;
    }
    printk("raw adc value: %d\n", buf);

    // convert raw ADC reading to voltage
    int32_t v_adc = (buf * ADC_FULL_SCALE_MV) / ADC_RESOLUTION;
    printk("convert voltage: %d mV\n", v_adc);

    // scale back to actual battery voltage using voltage divider
    int32_t v_bat = (v_adc * DIVIDER_RATIO_NUM) / DIVIDER_RATIO_DEN;

    // clamp voltage within battery range
    if (v_bat > BATTERY_MAX_VOLTAGE) v_bat = BATTERY_MAX_VOLTAGE;
    if (v_bat < BATTERY_MIN_VOLTAGE) v_bat = BATTERY_MIN_VOLTAGE + 1;
    printk("clamped voltage: %d mV\n", v_bat);

    // non-linear scaling
    int32_t range = BATTERY_MAX_VOLTAGE - BATTERY_MIN_VOLTAGE;
    int32_t difference = v_bat - BATTERY_MIN_VOLTAGE;

    if (range > 0 && difference > 0) {
        double normalized = (double)difference / range;  // normalize to range [0, 1]
        double scaled = pow(normalized, 1.2);            // apply non-linear scaling
        percent = (int16_t)(scaled * 100);       // convert to percentage
    } else {
        printk("invalid range or difference\n");
        percent = 0;
    }

    printk("battery level (non-linear, int16): %d%%\n", percent);
    return percent;
}
```

## src/app_vbat.h
```c
/*
 * Copyright (c) 2025
 * Regis Rousseau
 * Univ Lyon, INSA Lyon, Inria, CITI, EA3720
 * SPDX-License-Identifier: Apache-2.0
 */

#ifndef APP_VBAT_H
#define APP_VBAT_H

//  ========== includes ====================================================================
#include <zephyr/kernel.h>
#include <zephyr/device.h>
#include <zephyr/devicetree.h>
#include <zephyr/drivers/adc.h>
#include <math.h>

//  ========== defines =====================================================================
// ADC characteristics (nRF52 SAADC)
#define ADC_REF_INTERNAL_MV         600     // 0.6 V internal reference
#define ADC_GAIN                    6       // using ADC_GAIN_1_6
#define ADC_RESOLUTION              4096    // 12-bit

// effective full-scale voltage in mV
#define ADC_FULL_SCALE_MV   ((ADC_REF_INTERNAL_MV * ADC_GAIN))  // 3600 mV

// voltage divider correction
#define DIVIDER_RATIO_NUM           4600    // (R4 + R5)
#define DIVIDER_RATIO_DEN           3600   // R5
#define DIVIDER_CORRECTION          ((DIVIDER_RATIO_NUM * 1000) / DIVIDER_RATIO_DEN) // ≈1280

// battery thresholds (in mV, actual battery voltage!)
#define BATTERY_MAX_VOLTAGE         2980
#define BATTERY_MIN_VOLTAGE         2270

//  ========== prototypes ==================================================================
int8_t app_nrf52_vbat_init();
int16_t app_nrf52_get_vbat();

#endif /* APP_VBAT_H */
```
